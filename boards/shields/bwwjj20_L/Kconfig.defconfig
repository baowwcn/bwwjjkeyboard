## boards/shields/bwwjj40/Kconfig.shield
```kconfig
config SHIELD_bwwjj40_LEFT
    def_bool $(shields_list_contains,bwwjj40_left)

config SHIELD_bwwjj40_RIGHT
    def_bool $(shields_list_contains,bwwjj40_right)
```

## boards/shields/bwwjjkeyboard20_L/Kconfig.defconfig
```kconfig
if SHIELD_bwwjjkeyboard20_L

config ZMK_KEYBOARD_NAME
    default "bwwjjkeyboard20_L"

endif
```

## boards/shields/bwwjjkeyboard20_L/Kconfig.shield
```kconfig
config SHIELD_bwwjjkeyboard20_L
    def_bool $(shields_list_contains,bwwjjkeyboard20_L)
```

## boards/shields/bwwjjkeyboard40/Kconfig.defconfig
```kconfig
if SHIELD_bwwjj40_LEFT

config ZMK_KEYBOARD_NAME
    default "bwwjj40"

config ZMK_SPLIT_ROLE_CENTRAL
    default y

endif

if SHIELD_bwwjj40_LEFT || SHIELD_bwwjj40_RIGHT

config ZMK_SPLIT
    default y

endif
```

## boards/shields/bwwjjkeyboard40/Kconfig.shield
```kconfig
config SHIELD_bwwjjkeyboard40_LEFT
    def_bool $(shields_list_contains,bwwjjkeyboard40_left)

config SHIELD_bwwjjkeyboard40_RIGHT
    def_bool $(shields_list_contains,bwwjjkeyboard40_right)
```
